## boards/shields/choco50/Kconfig.defconfig
```kconfig
if SHIELD_CHOCO50_LEFT

# Name must be less than 16 characters long!
config ZMK_KEYBOARD_NAME
    default "Choco50"

config ZMK_SPLIT_ROLE_CENTRAL
    default y

endif

if SHIELD_CHOCO50_LEFT || SHIELD_CHOCO50_RIGHT

config ZMK_SPLIT
    default y

endif
```

## boards/shields/choco50/Kconfig.shield
```kconfig
# No whitespace after the comma or in your part name!
config SHIELD_CHOCO50_LEFT
    def_bool $(shields_list_contains,choco50_left)

# No whitespace after the comma or in your part name!
config SHIELD_CHOCO50_RIGHT
    def_bool $(shields_list_contains,choco50_right)
```
